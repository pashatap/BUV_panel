#include "stm32f4xx.h"
#include "Font_Processor.h"


extern uint32_t BackgroundColor;
extern uint32_t BasicSymbolColor;
extern uint32_t VideoBuffer;


const char AlarmsEvents54Jurnal [] = {
		 80,102,113,102,100,113,116,104,107, 97, 32, 85, 49, 32, 32, 32, 32, 32, 32, 32, 32, 32, 32, 32, 32, 32, 32, 32, 32, 32, 32, 32, //  1 Перегрузка Ф1
		 75,111,113,111,115,107,111,102, 32,104, 97,109,124,107, 97,110,105,102, 32, 85, 49, 32, 32, 32, 32, 32, 32, 32, 32, 32, 32, 32, //  2 Короткое замыкание Ф1
		 80,102,113,102,107,111,114, 32,117, 97,104, 32, 85, 49, 32, 32, 32, 32, 32, 32, 32, 32, 32, 32, 32, 32, 32, 32, 32, 32, 32, 32, //  3 Перекос фаз Ф1
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		 79, 98,113,124, 99, 32,104, 97,104,102,109,108,102,110,105,128, 32, 85, 49, 49, 32, 32, 32, 32, 32, 32, 32, 32, 32, 32, 32, 32, // 124 Обрыв заземления Ф11
};


const char Events54Jurnal [] = {
		 80,105,115, 97,110,105,102, 32, 99,107,108,127,120,102,110,111, 32, 32, 32, 32, 32, 32, 32, 32, 32, 32, 32, 32, 32, 32, 32, 32, //  1 Питание включено
		 83,102,114,115, 32,104, 97,122,105,115, 32,112,113,111,106,101,102,110, 32, 32, 32, 32, 32, 32, 32, 32, 32, 32, 32, 32, 32, 32, //  2 Тест защит пройден
		 83,102,114,115, 32,104, 97,122,105,115, 32,110,102, 32,112,113,111,106,101,102,110, 32, 32, 32, 32, 32, 32, 32, 32, 32, 32, 32, //  3 Тест защит не пройден
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		 80,102,113,102,110,111,114,110,111,102, 32, 99,113, 97,122,102,110,105,102, 32,111,115,107,108, 32, 32, 32, 32, 32, 32, 32, 32, // 44 Переносное вращение откл
};

void PrintTimeCode(uint16_t Coord_X, uint16_t Coord_Y, uint32_t Pointer_TimeAndDate, uint32_t Font_Color, uint32_t Symbol_Color, uint16_t Size, uint32_t PageNumber)
{
	struct {uint8_t minute, second, day, hour, year, month;} *TimeDataPack=Pointer_TimeAndDate;

	char String[10];
	char StringOut[10];
	char StringOut2[10];
	char StringOut3[20];

	uint8_t Cycle_Pointer;

	itoa(TimeDataPack[0].second, String, 10);

	Cycle_Pointer = 0;
	while(String[Cycle_Pointer] > 0) //подсчёт длинны числа
	{Cycle_Pointer++;}
	if(Cycle_Pointer<2){String[1] = String[0]; String[0] = '0';}

	StringOut[0] = String[0];
	StringOut[1] = String[1];
	StringOut[2] = ':';

	itoa(TimeDataPack[0].minute, String, 10);

	Cycle_Pointer = 0;
	while(String[Cycle_Pointer] > 0) //подсчёт длинны числа
	{Cycle_Pointer++;}
	if(Cycle_Pointer<2){String[1] = String[0]; String[0] = '0';}

	StringOut[3] = String[0];
	StringOut[4] = String[1];
	StringOut[5] = ':';

	itoa(TimeDataPack[0].hour, String, 10);

	Cycle_Pointer = 0;
	while(String[Cycle_Pointer] > 0) //подсчёт длинны числа
	{Cycle_Pointer++;}
	if(Cycle_Pointer<2){String[1] = String[0]; String[0] = '0';}

	StringOut[6] = String[0];
	StringOut[7] = String[1];

	itoa(TimeDataPack[0].day, String, 10);

	Cycle_Pointer = 0;
	while(String[Cycle_Pointer] > 0) //подсчёт длинны числа
	{Cycle_Pointer++;}
	if(Cycle_Pointer<2){String[1] = String[0]; String[0] = '0';}

	StringOut2[0] = String[0];
	StringOut2[1] = String[1];
	StringOut2[2] = '/';

	itoa(TimeDataPack[0].month, String, 10);

	Cycle_Pointer = 0;
	while(String[Cycle_Pointer] > 0) //подсчёт длинны числа
	{Cycle_Pointer++;}
	if(Cycle_Pointer<2){String[1] = String[0]; String[0] = '0';}

	StringOut2[3] = String[0];
	StringOut2[4] = String[1];
	StringOut2[5] = '/';

	itoa((TimeDataPack[0].year + 2000), String, 10);

	Cycle_Pointer = 0;
	while(String[Cycle_Pointer] > 0) //подсчёт длинны числа
	{Cycle_Pointer++;}
	if(Cycle_Pointer<2){String[1] = String[0]; String[0] = '0';}

	StringOut2[6] = String[0];
	StringOut2[7] = String[1];
	StringOut2[8] = String[2];
	StringOut2[9] = String[3];

	for(int i=0;i<8;i++)
	{
		StringOut3[i] = StringOut[i];
	}

	StringOut3[8] = 32;

	for(int i=0;i<10;i++)
	{
		StringOut3[i + 9] = StringOut2[i];
	}

	Coord_Y = Coord_Y - (19 / 2);
	if(Size)
	{
		DrawString_16(StringOut3, 9, Coord_X + 10, Coord_Y + 20, 800, 480, PageNumber, Font_Color, Symbol_Color, Arial_11x18_Table, 11, 18);
		DrawString_16(StringOut2, 10, Coord_X, Coord_Y, 800, 480, PageNumber, Font_Color, Symbol_Color, Arial_11x18_Table, 11, 18);
	}
	else
	{
		DrawString_16(StringOut3, 19, Coord_X, Coord_Y, 800, 480, PageNumber, Font_Color, Symbol_Color, Arial_11x18_Table, 11, 18);
	}
}



void Draw_RU_Event_From_Database_32(uint16_t N_of_mess, uint32_t EventsJurnalPointer, uint16_t Coord_X,
		uint16_t Coord_Y, uint32_t Page, uint32_t Background)
{
	if(N_of_mess)
	{
		char String[70];
		struct {char A;} *StringBuf=EventsJurnalPointer;
		memcpy(&String, &StringBuf[(N_of_mess - 1)*32].A, 70);

		Coord_Y = Coord_Y - (27 / 2) - 4;
		RU_DrawString_32(String, 32, Coord_X, Coord_Y, 800, 480, Page, Background, BasicSymbolColor, RU_18x27_Table, 18, 27);
	}
}

void Draw_RU_Event_From_Database_32_To_MainScreen(uint16_t N_of_mess, uint32_t EventsJurnalPointer, uint16_t Coord_X,
		uint16_t Coord_Y, uint32_t Page, uint32_t Background)
{
	if(N_of_mess)
	{
		char String[70];
		struct {char A;} *StringBuf=EventsJurnalPointer;
		memcpy(&String, &StringBuf[(N_of_mess - 1)*32].A, 70);

		RU_DrawString_32(String, 29, Coord_X, Coord_Y, 800, 480, Page, Background, BasicSymbolColor, RU_18x27_Table, 18, 27);
	}
}

void PrintAlarmString(uint16_t Coord_Y, uint32_t Pointer_Data, uint32_t Pointer_Table, uint32_t Page, uint32_t Background)
{
	struct {int16_t Data;} *Data=Pointer_Data;

	if(Data[0].Data)
	{
		Draw_RU_Event_From_Database_32(Data[0].Data, Pointer_Table, 0, Coord_Y, Page, Background);
		PrintTimeCode(585, Coord_Y, &Data[1].Data, Background, BasicSymbolColor, 0, Page);
	}
	else{
		Draw_Rectangle(Background, 10, (Coord_Y - (27 / 2) - 4), 800, 27, Page, 800, 480);
	}
}

void PrintAlarmStringForMain( uint16_t Coord_X, uint16_t Coord_Y, uint32_t Pointer_Data, uint32_t Pointer_Table, uint32_t Page, uint32_t Background)
{
	struct {int16_t Data;} *Data=Pointer_Data;

	if(Data[0].Data)
	{
		Draw_RU_Event_From_Database_32_To_MainScreen(Data[0].Data, Pointer_Table, Coord_X, Coord_Y, Page, Background);
	}
	else{
		Draw_Rectangle(Background, Coord_X, Coord_Y, 525, 27, Page, 800, 480);
	}
}

